## config/west.yml
```yaml
manifest:
  remotes:
    # zmk official
    - name: zmkfirmware
      url-base: https://github.com/zmkfirmware
      # bravekarma
    - name: caksoylar
      url-base: https://github.com/caksoylar
      # kyek / duckyb
    - name: duckyb
      url-base: https://github.com/duckyb
     #petejohanson
    - name: petejohanson
      url-base: https://github.com/petejohanson
  projects:
    - name: urchin-zmk-module
      remote: duckyb
      revision: main
    - name: zmk
      remote: petejohanson
      revision: main
      import: app/west.yml
  self:
    path: config
```
